## firmware/config/sdkconfig.defaults.radio
```kconfig
CONFIG_AUDIO_OUTPUT_SPDIF=y
CONFIG_SPDIF_DO_IO=14
CONFIG_I2S_GND_IO=-1
CONFIG_OUTPUT_SAMPLE_RATE_48000=y
CONFIG_ESPTOOLPY_FLASHMODE_DIO=y
CONFIG_MBEDTLS_CERTIFICATE_BUNDLE=y
CONFIG_PARTITION_TABLE_CUSTOM_FILENAME="components/boards/partitions-radio.csv"
```
